// Digital business card for the M5StickS3
//
// Switch it on:
//   - Instagram QR code, then the flying-kick figure, over and over
//   - press nothing for 30 seconds and it switches itself off
//
// While it is on:
//   - big front button      -> Telegram QR code
//   - small side button     -> LinkedIn QR code
//   - shake the stick       -> website QR code
//   A QR code stays for one minute, then the stick switches itself off.
//   While a QR is showing, a button or a shake jumps straight to that other QR.
//
// Getting back to the loop from a QR code:
//   - hold either button for about half a second, or
//   - if the website QR is showing, shake again
//
// Arduino IDE: board = M5StickS3 (M5Stack package), library = M5Unified.

#include <M5Unified.h>
#include <esp_sleep.h>

// ---------- Things you can change ----------
const char* igLink     = "https://instagram.com/YOUR_USERNAME";
const char* igLabel    = "INSTAGRAM";
const char* igSmall    = "@your_username";

const char* tgLink     = "https://t.me/YOUR_USERNAME";
const char* tgLabel    = "TELEGRAM";
const char* tgSmall    = "@your_username";

const char* liLink     = "https://linkedin.com/in/YOUR_PROFILE";
const char* liLabel    = "LINKEDIN";
const char* liSmall    = "Your Name";

const char* webLink    = "https://www.YOUR-WEBSITE.com";
const char* webLabel   = "WEBSITE";
const char* webSmall   = "your-website.com";

const int   screenTurn = 1;        // 1 = sideways. If the picture is upside down, change to 3
const int   nameTime   = 3000;     // ms the Instagram QR stays on screen in the loop
const int   kickHold   = 1200;     // ms the figure stops in the middle
const int   slideStep  = 5;        // pixels the figure moves per frame (bigger = faster)
const int   frameTime  = 25;       // ms per frame

const unsigned long loopOffTime = 30000;   // ms of loop with no press before it switches off
const unsigned long qrOffTime   = 60000;   // ms a QR code stays before it switches off

const float shakeStrength = 2.3;   // how hard a shake must be. Bigger = harder. Try 1.8 to 3.0
const bool  clickSound    = true;  // short click on button presses. false = silent
const int   clickVolume   = 90;    // 0 to 255. Keep under 190 on battery
const int   clickLength   = 120;   // ms the click lasts. Shorter than about 80 can go silent
const int   holdTime      = 600;   // ms a button must be held to count as a long press

// ---------- The kick figure: 142 x 104 pixels, full colour ----------
#define KICK_W 142
#define KICK_H 104
const uint16_t kickPic[] PROGMEM = {
  0x0000,0x0000,0x0000,0x0000,0x0000,0x0000,0x0000,0x0000,0x0000,0x0000,0x0000,0x0000,0x0000,0x0000,0x0000,0x0000,
  0x0000,0x0000,0x0000,0x0000,0x0000,0x0000,0x0000,0x0000,0x0000,0x0000,0x0000,0x0000,0x0000,0x0000,0x0000,0x0000,
  0x0000,0x0000,0x0000,0x0000,0x0000,0x0000,0x0000,0x0000,0x0000,0x0000,0x0000,0x0000,0x0000,0x0000,0x0000,0x0000,
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  0x0000,0x0000,0x0000,0x0000,0x0000,0x0000,0x0000,0x0000,0x0000,0x0000,0x0000,0x0000,0x0000,0x0000,0x0000,0x0000,
};

M5Canvas screen(&M5.Display);   // everything is drawn here first, so nothing flickers
M5Canvas kick(&screen);         // the figure, drawn once at start
uint16_t purple;
uint16_t cyan;

// Which QR code was asked for
const int NONE = 0;
const int TELEGRAM = 1;
const int LINKEDIN = 2;
const int WEBSITE = 3;
const int BACK = 4;                  // long press: back to the loop

unsigned long lastTouch = 0;        // last time a button was pressed or the stick was shaken
unsigned long shakeBlockUntil = 0;  // shakes are ignored until this time
unsigned long batteryReadAt = 0;
int batteryLevel = -1;

// ---------- Switching off ----------
void powerDown() {
  M5.Display.fillScreen(TFT_BLACK);
  M5.Display.setBrightness(0);
  M5.Power.powerOff();
  // If the stick is still running here, sleep instead. One click of the side button wakes it.
  delay(500);
  M5.Display.sleep();
  esp_deep_sleep_start();
}

// ---------- Buttons and shake ----------
void click() {
  if (!clickSound) return;
  // The speaker takes a moment to wake up after being quiet, and a very short
  // sound can be swallowed while it does. So the click is long enough to survive that.
  M5.Speaker.tone(4000, clickLength);
}

bool shaken() {
  if (millis() < shakeBlockUntil) return false;
  float ax = 0, ay = 0, az = 0;
  if (!M5.Imu.getAccel(&ax, &ay, &az)) return false;
  float force = sqrtf(ax * ax + ay * ay + az * az);   // 1.0 when the stick is still
  if (force > shakeStrength) {
    shakeBlockUntil = millis() + 1500;   // one shake counts once
    return true;
  }
  return false;
}

// Looks at the two buttons and the shake sensor. Returns which QR was asked for, or NONE.
int checkInputs() {
  M5.update();
  int asked = NONE;
  if (M5.BtnA.wasHold() || M5.BtnB.wasHold()) { asked = BACK; click(); }   // held down
  else if (M5.BtnA.wasClicked())              { asked = TELEGRAM; click(); }   // short press, on release
  else if (M5.BtnB.wasClicked())              { asked = LINKEDIN; click(); }
  else if (shaken())                          { asked = WEBSITE; }
  if (asked != NONE) lastTouch = millis();
  return asked;
}

// Waits, but keeps watching the buttons. Used by the loop animation.
int waitFor(unsigned long ms) {
  unsigned long start = millis();
  while (millis() - start < ms) {
    int asked = checkInputs();
    if (asked != NONE && asked != BACK) return asked;   // a long press does nothing during the loop
    if (millis() - lastTouch > loopOffTime) powerDown();
    delay(5);
  }
  return NONE;
}

// ---------- Battery, small in the corner ----------
void drawBattery() {
  if (batteryLevel < 0 || millis() - batteryReadAt > 5000) {
    batteryLevel = M5.Power.getBatteryLevel();
    batteryReadAt = millis();
  }
  if (batteryLevel < 0) return;
  char text[8];
  snprintf(text, sizeof(text), "%d%%", batteryLevel);
  screen.setFont(&fonts::Font0);
  screen.setTextDatum(top_right);
  screen.setTextColor(cyan);
  screen.drawString(text, screen.width() - 3, 3);
}

// ---------- The loop: Instagram QR, then kick ----------
int showName() {
  int side = screen.height() - 4;           // white square, almost full height
  int left = screen.width() - side - 2;     // pushed to the right edge
  int textMiddle = left / 2;                // the label sits in the space on the left

  screen.fillScreen(TFT_BLACK);
  screen.fillRect(left, 2, side, side, TFT_WHITE);
  screen.qrcode(igLink, left + 6, 8, side - 12, 3);

  screen.setTextDatum(middle_center);
  screen.setTextColor(purple);
  screen.setFont(&fonts::FreeSansBold9pt7b);
  if (screen.textWidth(igLabel) > left - 6) screen.setFont(&fonts::Font2);
  screen.drawString(igLabel, textMiddle, screen.height() / 2 - 10);

  screen.setTextColor(cyan);
  screen.setFont(&fonts::Font0);
  screen.drawString(igSmall, textMiddle, screen.height() / 2 + 12);

  // battery goes top left here, because the QR fills the right side
  if (batteryLevel < 0 || millis() - batteryReadAt > 5000) {
    batteryLevel = M5.Power.getBatteryLevel();
    batteryReadAt = millis();
  }
  if (batteryLevel >= 0) {
    char text[8];
    snprintf(text, sizeof(text), "%d%%", batteryLevel);
    screen.setTextDatum(top_left);
    screen.drawString(text, 3, 3);
  }

  screen.pushSprite(0, 0);
  return waitFor(nameTime);
}

void drawKickAt(int x) {
  screen.fillScreen(TFT_BLACK);
  kick.pushSprite(x, (screen.height() - KICK_H) / 2);
  drawBattery();
  screen.pushSprite(0, 0);
}

int showKick() {
  int asked = NONE;
  int middle = (screen.width() - KICK_W) / 2;
  // comes in from the right, foot first
  for (int x = screen.width(); x > middle; x -= slideStep) {
    drawKickAt(x);
    asked = waitFor(frameTime);
    if (asked != NONE) return asked;
  }
  drawKickAt(middle);
  asked = waitFor(kickHold);
  if (asked != NONE) return asked;
  // leaves on the left
  for (int x = middle; x > -KICK_W; x -= slideStep) {
    drawKickAt(x);
    asked = waitFor(frameTime);
    if (asked != NONE) return asked;
  }
  return NONE;
}

// ---------- The QR codes ----------
void drawQR(int which) {
  const char* link  = tgLink;
  const char* label = tgLabel;
  const char* small = tgSmall;
  if (which == LINKEDIN) { link = liLink;  label = liLabel;  small = liSmall; }
  if (which == WEBSITE)  { link = webLink; label = webLabel; small = webSmall; }

  int side = M5.Display.height() - 4;               // white square, almost full height
  int left = M5.Display.width() - side - 2;         // pushed to the right edge
  int textMiddle = left / 2;                        // the label sits in the space on the left

  M5.Display.fillScreen(TFT_BLACK);
  M5.Display.fillRect(left, 2, side, side, TFT_WHITE);
  M5.Display.qrcode(link, left + 6, 8, side - 12, 3);

  M5.Display.setTextDatum(middle_center);
  M5.Display.setTextColor(purple, TFT_BLACK);
  M5.Display.setFont(&fonts::FreeSansBold9pt7b);
  if (M5.Display.textWidth(label) > left - 6) {
    M5.Display.setFont(&fonts::Font2);
  }
  M5.Display.drawString(label, textMiddle, M5.Display.height() / 2 - 10);

  M5.Display.setTextColor(cyan, TFT_BLACK);
  M5.Display.setFont(&fonts::Font0);
  M5.Display.drawString(small, textMiddle, M5.Display.height() / 2 + 12);
}

// Shows a QR code. A button or a shake jumps to another one.
// A long press, or a second shake on the website, goes back to the loop.
// After one minute with nothing pressed, the stick switches off.
void qrMode(int which) {
  while (true) {
    drawQR(which);
    shakeBlockUntil = millis() + 1500;     // let the stick settle before a shake counts
    unsigned long shownAt = millis();
    int next = NONE;
    while (millis() - shownAt < qrOffTime) {
      next = checkInputs();
      if (next == BACK) return;                                 // long press: back to the loop
      if (next == WEBSITE && which == WEBSITE) return;          // shake again on the website: back to the loop
      if (next == which) { shownAt = millis(); next = NONE; }   // same one again: a fresh minute
      if (next != NONE) break;
      delay(10);
    }
    if (next == NONE) powerDown();
    which = next;
  }
}

void setup() {
  auto cfg = M5.config();
  M5.begin(cfg);
  M5.Display.setRotation(screenTurn);
  M5.Display.setBrightness(200);
  M5.Display.fillScreen(TFT_BLACK);
  M5.Speaker.setVolume(clickVolume);
  M5.BtnA.setHoldThresh(holdTime);
  M5.BtnB.setHoldThresh(holdTime);

  purple = M5.Display.color565(170, 60, 255);
  cyan   = M5.Display.color565(0, 220, 255);

  screen.setColorDepth(16);
  screen.createSprite(M5.Display.width(), M5.Display.height());

  // Copy the figure into its own sprite, one pixel at a time
  kick.setColorDepth(16);
  kick.createSprite(KICK_W, KICK_H);
  for (int y = 0; y < KICK_H; y++) {
    for (int x = 0; x < KICK_W; x++) {
      uint16_t c = pgm_read_word(&kickPic[y * KICK_W + x]);
      uint8_t r = ((c >> 11) & 0x1F) << 3;
      uint8_t g = ((c >> 5) & 0x3F) << 2;
      uint8_t b = (c & 0x1F) << 3;
      kick.drawPixel(x, y, kick.color565(r, g, b));
    }
  }

  lastTouch = millis();
  shakeBlockUntil = millis() + 1500;   // ignore the movement of switching it on
}

void loop() {
  int asked = showName();
  if (asked == NONE) asked = showKick();
  if (asked != NONE) qrMode(asked);
}